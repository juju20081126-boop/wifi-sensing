## firmware-radar/main/Kconfig.projbuild
```kconfig
menu "Presence radar configuration"

    config RADAR_WIFI_SSID
        string "WiFi SSID to connect to (2.4 GHz)"
        default "myssid"
        help
            esp-radar reads CSI off this station connection, so the router
            must be on 2.4 GHz. This chip cannot join a 5 GHz network.

    config RADAR_WIFI_PASSWORD
        string "WiFi password"
        default "mypassword"

    config RADAR_PRESENCE_GPIO
        int "GPIO driven high while presence_fusion reports occupied"
        default 4
        range 0 39

    config RADAR_MOVEMENT_GPIO
        int "GPIO driven high while jitter-based movement is active"
        default 5
        range 0 39

endmenu
```
